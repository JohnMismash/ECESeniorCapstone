# file: Top_STM.ioc
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Mcu.Family=STM32F0
Mcu.Name=STM32F072R(8-B)Tx
Mcu.Package=LQFP64
ProjectManager.HeapSize=0x200
ProjectManager.StackSize=0x400
ProjectManager.TargetToolchain=MDK-ARM V5
board=custom

// file: Core/Src/main.c
/* USER CODE BEGIN Header */
/** ECE 3992/4710 FINAL PROJECT CODE - TOP MICROCONTROLLER BOARD

PIN ASSIGNMENT:
PB10/PB11 - USART Interface
PC0 - Distance Sensor (White Wire)
PA0 - limit switch

----------------------------------------------------------------------------
HOW	TO WIRE THE UART CONNECTION:
1. Ground on top board goes to ground on bottom board
2. PB10 on top board goes to PB11 on bottom board
3. PB11 on top board goes to PB10 on bottom board
----------------------------------------------------------------------------

---------------------------------------------------------------------------
HOW	TO WIRE THE LIMIT SWITCH:
1. Black wire goes to PA0 (It is NOT grounded!)
2. Yellow wire goes to 3V pin on board
---------------------------------------------------------------------------

----------------------------------------------------------------------------
HOW	TO WIRE THE DISTANCE SENSOR:
1. Red wire goes to 5 volts on the board
2. Black wire goes to ground on the board
3. White wire goes to PC0 on the board
----------------------------------------------------------------------------

V1 Implementation of Inter-board communication via UART.  Boards will speak to each other
		Testing will involve pressing a button to signal another STM board to turn on an LED

V2 Removing interrupt and implementing a fire-and-forget message protocol.
	 If the package is sensed, send the start motor signal. Do not check for top switch until that register is no longer high. Then next
	 time that it is high, we want to fire the stop motor message and be ready to receive another package.

******************************************************************************
* @file           : main.c
* @brief          : Main program body for the TOP microcontroller
* @authors				: John (Jack) Mismash, u1179865 - University of Utah - ECE 5780
*						  			Andrew Porter, u1071655 - University of Utah - ECE 5780
*						  			Tony Robinson, u0531330 - University of Utah - ECE 5780
*						  			Lindsey Enders, u1250233 - University of Utah - ECE 5780
******************************************************************************
* @attention
*
* Copyright (c) 2022 STMicroelectronics.
* All rights reserved.
*
* This software is licensed under terms that can be found in the LICENSE file
* in the root directory of this software component.
* If no LICENSE file comes with this software, it is provided AS-IS.
*
******************************************************************************
*/

/* USER CODE END Header */
#include "main.h"

/* USER CODE BEGIN PV */

char START_MOTOR = 'S';
char STOP_MOTOR = 'X';

/* USER CODE END PV */

void SystemClock_Config(void);

/* USER CODE BEGIN PFP */
void TransmitChar (char );
void TransmitString (char* );
void TransmitToBottomBoard(char);
void LED_Init(void);
void USART_Init(void);
void DistanceSensor_Init(void);
void LimitSwitch_Init(void);

int READY_TO_GO;

int INITIAL_STATE;

/* USER CODE END PFP */

int main(void)
{
  HAL_Init();
  SystemClock_Config();

  /* USER CODE BEGIN SysInit */
	__HAL_RCC_GPIOA_CLK_ENABLE();
	__HAL_RCC_GPIOB_CLK_ENABLE();
	__HAL_RCC_USART3_CLK_ENABLE();

  /* USER CODE END SysInit */

  /* Initialize all configured peripherals */
	LED_Init();
	USART_Init();
  LimitSwitch_Init();
	DistanceSensor_Init(); // PC0

  /* USER CODE BEGIN WHILE */
  int readVal;
  int count = 0;

  READY_TO_GO = 1;
	INITIAL_STATE = 1;

  while (1){

		HAL_GPIO_TogglePin(GPIOC, GPIO_PIN_8); //Orange is waitin
   //range on readVal is aprox between 500 and 3000
		//CODE DETECTS FOR PACKAGE THAT IS IN PLACE FOR 100 cycles
		readVal = ADC1->DR;
		if(readVal > 2000){
      count++;
			GPIOC->ODR |= (1<<9);  //green
    }
		else{
      GPIOC->ODR &= ~(1<<6);  //red
      GPIOC->ODR &= ~(1<<7);  //blue
      //GPIOC->ODR &= ~(1<<8);  //orange
      GPIOC->ODR &= ~(1<<9);  //green
      count=0;
   }

    // Triggers true if package is present. Able to send signal to start motor
    if( (count>100) && READY_TO_GO){
	    READY_TO_GO = 0;

      TransmitToBottomBoard(START_MOTOR);
			GPIOC->ODR |= (1<<7);  //blue
    }

		//This will detect when the top limit switch is triggered
		if(GPIOA->IDR & (0x1)) { //Read PA0 value for top limit switch
			HAL_GPIO_WritePin(GPIOC, GPIO_PIN_6, GPIO_PIN_SET); //RED is waitin

			//Condition where we just got a package and the top limit switch is high. At beginning of lift cycle the top switch is triggered because
			//the up resting position pushes on the switch.
			if(INITIAL_STATE){
				//Don't worry about it
				HAL_GPIO_WritePin(GPIOC, GPIO_PIN_7, GPIO_PIN_SET); //Orange is waitin

				continue;
			}

			//The lift must be coming back up and we have to send the signal to stop
			else{
				//Stop the motor i.e. fire and forget
				TransmitToBottomBoard(STOP_MOTOR);

				//Pause to allow the motor to stop.
				HAL_Delay(1000);

				//Prepare to receive next package
				READY_TO_GO = 1;
				INITIAL_STATE = 1;
				count = 0;
			}
		}

		else{ // If the board is not detecting the limit switch, then it is not at the top and we are no longer in the initial state.
			INITIAL_STATE = 0;
		}
  }
}

// INITIALIZE LED PINS
void LED_Init(void){
	__HAL_RCC_GPIOC_CLK_ENABLE();

	// INIT LED PINS
	GPIO_InitTypeDef initStrLED = {GPIO_PIN_6| GPIO_PIN_7 | GPIO_PIN_8 | GPIO_PIN_9,
																 GPIO_MODE_OUTPUT_PP,
																 GPIO_SPEED_FREQ_LOW,
																 GPIO_NOPULL};

	// INIT PINS PC8, PC9, PC6 AND PC7
	HAL_GPIO_Init(GPIOC, &initStrLED);
}

// INITIALIZE USART INTERFACE
void USART_Init(void){
	// INITIALIZE THE TX LINE.
	GPIO_InitTypeDef initStr = {GPIO_PIN_10,
															GPIO_MODE_AF_PP,
															GPIO_SPEED_FREQ_LOW,
															GPIO_NOPULL};

	// THIS IS THE RX LINE.
	GPIO_InitTypeDef initStr1 = {GPIO_PIN_11,
															 GPIO_MODE_AF_PP,
															 GPIO_SPEED_FREQ_LOW,
															 GPIO_PULLUP};

	// INIT PIN 10 & 11.
	HAL_GPIO_Init(GPIOB, &initStr);
	HAL_GPIO_Init(GPIOB, &initStr1);

	//SETS ALTERNATE FUCTION 4 FOR PINS PB10 AND PB11
	GPIOB -> AFR[1] |= (1 << 10);
	GPIOB -> AFR[1] |= (1 << 14);

	HAL_RCC_GetHCLKFreq();

	// SET THE BAUD RATE TO 115200 BITS/SECOND
	USART3 -> BRR |= ((1 << 0) | (1 << 2) | (1 << 6));

  //set the enables on TX, Rx, then enable USART fully
  USART3->CR1 |= (1 << 3); //te
  USART3->CR1 |= (1 << 2); //re
  USART3->CR1 |= (1 << 0); //ue

  // ENABLE THE Receive Register Not Empty Interrupt (RNE)	.
	USART3 -> CR1 |= (1 << 5);

	// ENABLE THE USART PRIORITY IN THE NVIC.
	NVIC_EnableIRQ(USART3_4_IRQn);
}

// INITIALIZE LIMIT SWITCH INTERFACE
//When switch is triggered, a high voltage is sent to the pin so we want a ground signal when no input is given
void LimitSwitch_Init(void){

	// USE THE RCC TO ENABLE THE SYSCFG PERIPHERAL CLK
  __HAL_RCC_SYSCFG_CLK_ENABLE();

  // INIT PIN PA0 TO INPUT MODE.
  GPIO_InitTypeDef initStr = {GPIO_PIN_0,
															GPIO_MODE_INPUT,
															GPIO_SPEED_FREQ_LOW,
															GPIO_PULLDOWN};

  HAL_GPIO_Init(GPIOA, &initStr); // INIT PA0.

  /*EXTI -> IMR |= (1 << 0);         // CREATE AS A INTERRUPT SIGNAL, NOT EVENT SIGNAL.
  EXTI -> RTSR |= (1 << 0);	     	 // ENABLES RISING TRIGGER EVENT FOR PA0.
  SYSCFG -> EXTICR[0] |= 0;        // ROUTE PA0 TO THE EXTI INPUT LINE 0 (EXTI0).
  //NVIC_EnableIRQ(EXTI0_1_IRQn);    // ENABLE THE EXTI INTERRUPT.	*/
}

/*// LIMIT SWITCH INTERRUPT HANDLER
void EXTI0_1_IRQHandler(void){
  // Send signal to bottom board to turn off the motor
  TransmitToBottomBoard(STOP_MOTOR);

	GPIOC->ODR |= (1<<7);  //blue

  //Allow the distance sensor to begin sensing packages again
  READY_TO_GO = 1;

	//Indicate stopped motor
	stoppedMotor = 1;

	// TURN OFF THE INTERRUPT SIGNAL
	EXTI->PR |= (1<<0);

}
*/

// INITIALIZE DISTANCE SENSOR & ADC (ANALOG TO DIGITAL CONVERTER) INTERFACE
void DistanceSensor_Init(void){

  // Red wire is 5 volts
  // Black wire is ground
  // White wire is analog out
  RCC->AHBENR |=  RCC_AHBENR_GPIOCEN;

  //USE PC0
  //This is for enabling PC0
  GPIOC->MODER |= (0x3<<0);   // 11 in bit positions 1 and 0
  GPIOC->PUPDR &= ~(0x3<<0);

  //Enable the ADC1 in the RCC peripheral.
  RCC->APB2ENR |= RCC_APB2ENR_ADCEN;

  //Configure the ADC to 8-bit resolution, continuous conversion mode, hardware triggers disabled (software trigger only).
  ADC1->CFGR1 &= ~(0x3<<3);  //8 bits
  ADC1->CFGR1 |= (0x1<<4);   //8 bits
  ADC1->CFGR1 |= (0x1<<13);   //continuous conversion mode
  ADC1->CFGR1 &= ~(0x3<<3) ; //hardware triggers disabled (software trigger only)

  //Select/enable the input pin’s channel for ADC conversion.
  ADC1->CHSELR |= (1<<10);  // ADC_IN10 correlates to PC0   Search ADC_IN10 in the lab manual

  //Perform a self-calibration, enable, and start the ADC.

  //Calibration software procedure
  //1. Ensure that ADEN=0 and DMAEN=0
  //2. Set ADCAL=1
  //3. Wait until ADCAL=0
  //4. The calibration factor can be read from bits 6:0 of ADC_DR.

  //1
  if ( ((ADC1->CR & 0x1) >> 0) != 0){
    //ERROR
    GPIOC->ODR |= (1<<6);
  }

  if ( ((ADC1->CFGR1 & 0x1) >> 0) != 0){
    //ERROR
    GPIOC->ODR |= (1<<6);
  }

  //2
  ADC1->CR |= (0x1 << 31);

  //3
  while(((ADC1->CR & 0x80000000) >> 30) != 0){

  }

  //Follow this procedure to enable the ADC:
  // 1. Clear the ADRDY bit in ADC_ISR register by programming this bit to 1.
  // 2. Set ADEN=1 in the ADC_CR register.
  // 3. Wait until ADRDY=1 in the ADC_ISR register and continue to write ADEN=1 (ADRDY is set after the ADC startup time).
  //    This can be handled by interrupt if the interrupt is enabled by setting the ADRDYIE bit in the ADC_IER register.

  //1
  ADC1->ISR |= (0x1 << 0);

  //2
  ADC1->CR |= (0x1<<0);  //enable

  //3
  if ( ((ADC1->ISR & 0x1) >> 0) != 1){

  }

  ADC1->CR |= (0x1<<2);  //start

}

void SystemClock_Config(void)
{
  RCC_OscInitTypeDef RCC_OscInitStruct = {0};
  RCC_ClkInitTypeDef RCC_ClkInitStruct = {0};

  /** Initializes the RCC Oscillators according to the specified parameters
  * in the RCC_OscInitTypeDef structure.
  */
  RCC_OscInitStruct.OscillatorType = RCC_OSCILLATORTYPE_HSI;
  RCC_OscInitStruct.HSIState = RCC_HSI_ON;
  RCC_OscInitStruct.HSICalibrationValue = RCC_HSICALIBRATION_DEFAULT;
  RCC_OscInitStruct.PLL.PLLState = RCC_PLL_NONE;
  if (HAL_RCC_OscConfig(&RCC_OscInitStruct) != HAL_OK)
  {
    Error_Handler();
  }
  /** Initializes the CPU, AHB and APB buses clocks
  */
  RCC_ClkInitStruct.ClockType = RCC_CLOCKTYPE_HCLK|RCC_CLOCKTYPE_SYSCLK
                              |RCC_CLOCKTYPE_PCLK1;
  RCC_ClkInitStruct.SYSCLKSource = RCC_SYSCLKSOURCE_HSI;
  RCC_ClkInitStruct.AHBCLKDivider = RCC_SYSCLK_DIV1;
  RCC_ClkInitStruct.APB1CLKDivider = RCC_HCLK_DIV1;

  if (HAL_RCC_ClockConfig(&RCC_ClkInitStruct, FLASH_LATENCY_0) != HAL_OK)
  {
    Error_Handler();
  }
}

void Error_Handler(void)
{
  __disable_irq();
  while (1){}
}

/* Transmits a single character using USART communication. */
void TransmitChar (char x){
	while((USART3->ISR & (1 << 7)) == 0){
		// Do nothing while data is not transferred to the shift register
	}

	USART3->TDR = x;
}

/* Transmits a single string using USART communication. */
void TransmitString (char* x){
	char* p = x;

	while(*p != 0){
		TransmitChar(*p);
		p += 1;
	}
		return;
}
/* USER CODE END 4 */

/*void USART3_4_IRQHandler(void){

	// RECEIVE DATA WHEN INTERRUPT HANDLER IS TRIGGERED.
	uint8_t read_data = USART3 -> RDR;

	// BEGIN ACKNOWLEDGEMENT.
	ReceiveFromBottomBoard(read_data);

	// RESET FLAGS
	USART3 -> ISR &= ~(1<<5);// RXNE REGISTER
	USART3 -> ISR &= ~(1<<3);// ORE REGISTER
}
*/
// TRANSMITS A MESSAGE TO THE BOTTOM BOARD
void TransmitToBottomBoard(char myChar){

	/* MESSAGE FROM TOP BOARD TO BOTTOM BOARD */
	TransmitChar(myChar);

}
